## linux_5.10/drivers/soc/openEuler_mcs/Kconfig
```kconfig
menu "openEuler_mcs"

config MCS
	tristate "mcs_dev"
	default m
	depends on MCS_MAILBOX
	help	
	  openEuler mcs device for milkv-duo, will create a device file "/dev/mcs" for mcs user program,
	  support the kernel module for mcs in milkv-duo

source "drivers/soc/openEuler_mcs/mcs_cmdqu/Kconfig"

endmenu 
```

## linux_5.10/drivers/soc/openEuler_mcs/mcs_cmdqu/Kconfig
```kconfig
config MCS_MAILBOX
	bool "mcs mailbox dirver"
	default y
	depends on !CVI_MAILBOX
	help
	  mcs mailbox driver, support api for interrupt rtos core and handle the interrupt from rtos,
	  it is almost change from CVI_MAILBOX driver, just a extend
```
